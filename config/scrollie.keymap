#include <behaviors.dtsi>
#include <dt-bindings/zmk/keys.h>
#include <dt-bindings/zmk/mouse.h>

/ {
    keymap {
        compatible = "zmk,keymap";

        default_layer {
            display-name = "Base";
            bindings = <
                &msc SCRL_UP    // Key 1 (D0): Smooth Scroll Up
                &msc SCRL_DOWN  // Key 2 (D1): Smooth Scroll Down
            >;
        };
    };
};